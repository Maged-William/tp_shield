## config/boards/shields/trackpoint/Kconfig.defconfig
```kconfig
# Trackpoint Shield - Default Config
# SPDX-License-Identifier: MIT

if SHIELD_TRACKPOINT

config ZMK_KEYBOARD_NAME
	default "Trackpoint"

endif
```

## config/boards/shields/trackpoint/Kconfig.shield
```kconfig
# Trackpoint Shield - Shield Config
# SPDX-License-Identifier: MIT

config SHIELD_TRACKPOINT
	def_bool $(shields_list_contains,trackpoint)
```

## config/west.yml
```yaml
manifest:
  remotes:
    - name: badjeff
      url-base: https://github.com/badjeff
    - name: maged-william
      url-base: https://github.com/Maged-William

  projects:
    - name: zmk
      remote: badjeff
      revision: main
      import: app/west.yml

    - name: kb_zmk_ps2_mouse_trackpoint_driver
      remote: maged-william
      revision: stream-only-mode-split-fix

  self:
    path: config
```
